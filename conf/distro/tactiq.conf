## conf/machine/tactiq-qemu-x86.conf
```bitbake
#@TYPE: Machine
#@NAME: TactiQ QEMU x86_64
#@DESCRIPTION: TactiQ OS for QEMU x86_64

require conf/machine/qemux86-64.conf

MACHINEOVERRIDES =. "tactiq-vm:"

PREFERRED_PROVIDER_virtual/kernel = "linux-yocto"
PREFERRED_VERSION_linux-yocto = "6.6%"

SERIAL_CONSOLES = "115200;ttyS0"

IMAGE_FSTYPES = "ext4 tar.gz"

QB_SYSTEM_NAME = "qemu-system-x86_64"
QB_MEM = "-m 1024"
QB_OPT_APPEND = "-nographic -serial mon:stdio"
```

## conf/machine/tactiq-rock5a.conf
```bitbake
#@TYPE: Machine
#@NAME: TactiQ Rock 5A
#@DESCRIPTION: TactiQ OS on Radxa Rock 5A (RK3588S SoC)
require conf/machine/include/arm/armv8-2a/tune-cortexa76-cortexa55.inc
MACHINEOVERRIDES =. "tactiq-arm64:tactiq-rock5a:"
PREFERRED_PROVIDER_virtual/kernel = "linux-yocto"
PREFERRED_VERSION_linux-yocto = "6.6%"
KERNEL_IMAGETYPE = "Image"
KERNEL_DEVICETREE = "rockchip/rk3588s-rock-5a.dtb"
SERIAL_CONSOLES = "1500000;ttyS2"
PREFERRED_PROVIDER_virtual/bootloader = "u-boot-rockchip"
UBOOT_MACHINE = "rock5a-rk3588s_defconfig"
WKS_FILE = "tactiq-ab.wks.in"
IMAGE_BOOT_FILES = "idbloader.img u-boot.itb"
IMAGE_FSTYPES = "wic wic.gz ext4 tar.gz"
MACHINE_FEATURES = "tpm2 emmc gpio spi i2c"
MACHINE_EXTRA_RRECOMMENDS = ""
KBUILD_DEFCONFIG = "defconfig"
KCONFIG_MODE = "alldefconfig"
COMPATIBLE_MACHINE:tactiq-rock5a = "tactiq-rock5a"
```
